## sdkconfig.defaults
```kconfig
CONFIG_ESPTOOLPY_FLASHSIZE_8MB=y
CONFIG_PARTITION_TABLE_CUSTOM=y
CONFIG_PARTITION_TABLE_CUSTOM_FILENAME="partitions.csv"

CONFIG_COMPILER_OPTIMIZATION_PERF=y
CONFIG_ESP_DEFAULT_CPU_FREQ_MHZ_240=y

CONFIG_SPIRAM=y
CONFIG_SPIRAM_MODE_OCT=y
CONFIG_SPIRAM_SPEED_80M=y
CONFIG_SPIRAM_USE_MALLOC=y

# Keep Wi-Fi/network processing on Core 0 and camera DMA on Core 1.
CONFIG_ESP_WIFI_TASK_PINNED_TO_CORE_0=y
CONFIG_CAMERA_CORE1=y
CONFIG_CAMERA_PSRAM_DMA=y
```
